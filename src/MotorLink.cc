#include "MotorLink.h"

// --- Protocol and CRC (Must match the Orin) ---
constexpr uint8_t START_OF_FRAME = 0x7E;
#define CRC8_J1850_INIT 0xFF
#define CRC8_J1850_XOR_OUT 0xFF

const uint8_t CRC8_J1850_TABLE[256] = {
    0x00, 0x1D, 0x3A, 0x27, 0x74, 0x69, 0x4E, 0x53, 0xE8, 0xF5, 0xD2, 0xCF, 0x9C, 0x81, 0xA6, 0xBB,
    0xCD, 0xD0, 0xF7, 0xEA, 0xB9, 0xA4, 0x83, 0x9E, 0x25, 0x38, 0x1F, 0x02, 0x51, 0x4C, 0x6B, 0x76,
    0x87, 0x9A, 0xBD, 0xA0, 0xF3, 0xEE, 0xC9, 0xD4, 0x6F, 0x72, 0x55, 0x48, 0x1B, 0x06, 0x21, 0x3C,
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    0x7F, 0x62, 0x45, 0x58, 0x0B, 0x16, 0x31, 0x2C, 0x97, 0x8A, 0xAD, 0xB0, 0xE3, 0xFE, 0xD9, 0xC4
};

uint8_t calculate_crc8(const uint8_t* data, size_t len) {
    uint8_t crc = CRC8_J1850_INIT;
    for (size_t i = 0; i < len; ++i) {
        crc = CRC8_J1850_TABLE[crc ^ data[i]];
    }
    return crc ^ CRC8_J1850_XOR_OUT;
}
// --- End Protocol and CRC ---

MotorLink::MotorLink() {}

void MotorLink::begin(long baud_rate) {
    Serial.begin(baud_rate);
    while (!Serial) { /* Wait for USB serial */ }
}

void MotorLink::debugPrint(const char* message) {
    if (debug_enabled_) {
        // Use a special debug prefix that won't interfere with the protocol
        Serial.print("DEBUG: ");
        Serial.println(message);
    }
}

void MotorLink::debugPrint(const String& message) {
    debugPrint(message.c_str());
}

void MotorLink::update() {
    while (Serial.available()) {
        uint8_t byte = Serial.read();

        switch (current_state_) {
            case ParseState::WAITING_FOR_SOF:
                if (byte == START_OF_FRAME) {
                    current_state_ = ParseState::READING_LENGTH;
                }
                break;

            case ParseState::READING_LENGTH:
                payload_len_ = byte;
                if (payload_len_ == 0 || payload_len_ > WheelMotorCommand_size) {
                    current_state_ = ParseState::WAITING_FOR_SOF;
                } else {
                    bytes_received_ = 0;
                    current_state_ = ParseState::READING_PAYLOAD;
                }
                break;

            case ParseState::READING_PAYLOAD:
                rx_buffer_[bytes_received_++] = byte;

                if (bytes_received_ == payload_len_ + 1) { // Payload + CRC
                    const uint8_t* payload_ptr = rx_buffer_;
                    const uint8_t received_checksum = rx_buffer_[payload_len_];
                    uint8_t calculated_checksum = calculate_crc8(payload_ptr, payload_len_);

                    if (calculated_checksum == received_checksum) {
                        pb_istream_t stream = pb_istream_from_buffer(payload_ptr, payload_len_);
                        if (pb_decode(&stream, WheelMotorCommand_fields, &last_command_)) {
                            new_command_available_ = true;
                        }
                    }
                    current_state_ = ParseState::WAITING_FOR_SOF;
                }
                break;
        }
    }
}

bool MotorLink::readCommand(WheelMotorCommand& command) {
    if (new_command_available_) {
        command = last_command_;
        new_command_available_ = false;
        return true;
    }
    return false;
}

bool MotorLink::sendState(const WheelMotorState& state) {
    uint8_t payload_buffer[WheelMotorState_size];
    pb_ostream_t stream = pb_ostream_from_buffer(payload_buffer, sizeof(payload_buffer));

    if (!pb_encode(&stream, WheelMotorState_fields, &state)) {
        return false;
    }
    size_t payload_len = stream.bytes_written;

    uint8_t checksum = calculate_crc8(payload_buffer, payload_len);

    Serial.write(START_OF_FRAME);
    Serial.write(payload_len);
    Serial.write(payload_buffer, payload_len);
    Serial.write(checksum);

    return true;
}